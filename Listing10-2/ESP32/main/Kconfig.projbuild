## Listing10-2/ESP32/main/Kconfig.projbuild
```kconfig
menu "Listing10-2 Configuration"

    menu "I2C Controller"

        config I2C_CONTROLLER_SDA
            int "SDA GPIO Num"
            default 21
            help
                GPIO number for I2C Controller data line.

                Espressif ESP32 DevKitC V4      21
                Espressif ESP32-C3 DevKitC 02   18
                Sparkfun ESP32 Thing Plus       23
                Adafruit Feather Huzzah32       23
    
        config I2C_CONTROLLER_SCL
            int "SCL GPIO Num"
            default 22
            help
                GPIO number for I2C Controller clock line.

                Espressif ESP32 DevKitC V4      22
                Espressif ESP32-C3 DevKitC 02   19
                Sparkfun ESP32 Thing Plus       22
                Adafruit Feather Huzzah32       22

        config I2C_CONTROLLER_PORT_NUM
            int "Port Number"
            default 0
            help
                Port number for I2C Controller device.

        config I2C_CONTROLLER_FREQUENCY
            int "Controller Frequency"
            default 400000
            help
                I2C Speed of Controller device.
    endmenu

    menu "I2C MCP4725 DAC"
    
        config I2C_MCP4725_ADDRESS_1
            hex "MCP4725 DAC Address 1"
            default 0x60
            help
                Hardware Address of I2C Peripheral Port.
                
                Sparkfun MCP4725    0x60 or 0x61
                Adafruit MCP4725    0x62 or 0x63
                
        config I2C_MCP4725_ADDRESS_2
            hex "MCP4725 DAC Address 2"
            default 0x61
            help
                Hardware Address of I2C Peripheral Port.
                
                Sparkfun MCP4725    0x60 or 0x61
                Adafruit MCP4725    0x62 or 0x63

    endmenu

endmenu
```

## Listing10-2/ESP8266/main/Kconfig.projbuild
```kconfig
menu "Listing 10-2 Configuration"

    menu "I2C Controller"

        config I2C_CONTROLLER_SDA
            int "SDA GPIO Num"
            default 14
            help
                GPIO number for I2C Controller data line.

                Espressif ESP8266 DevKitC V1    14
                Adafruit Huzzah ESP8266 Feather 4

        config I2C_CONTROLLER_SCL
            int "SCL GPIO Num"
            default 2
            help
                GPIO number for I2C Controller clock line.

                Espressif ESP8266 DevKitC V1    2
                Adafruit Huzzah ESP8266 Feather 5

        config I2C_CONTROLLER_PORT_NUM
            int "Port Number"
            default 0
            help
                Port number for I2C Controller device.

    endmenu

    menu "I2C MCP4725 DAC"
    
        config I2C_MCP4725_ADDRESS_1
            hex "MCP4725 DAC Address 1"
            default 0x60
            help
                Hardware Address of I2C Peripheral Port.
                
                Sparkfun MCP4725    0x60 or 0x61
                Adafruit MCP4725    0x62 or 0x63
    
        config I2C_MCP4725_ADDRESS_2
            hex "MCP4725 DAC Address 2"
            default 0x61
            help
                Hardware Address of I2C Peripheral Port.
                
                Sparkfun MCP4725    0x60 or 0x61
                Adafruit MCP4725    0x62 or 0x63

    endmenu

endmenu
```

## Listing13-2/ESP32/main/Kconfig.projbuild
```kconfig
menu "Listing13-2 Configuration"

    menu "I2C Controller"

        config I2C_CONTROLLER_SDA
            int "SDA GPIO Num"
            default 21
            help
                GPIO number for I2C Controller data line.

                Espressif ESP32 DevKitC V4      21
                Espressif ESP32-C3 DevKitC 02   18
                Sparkfun ESP32 Thing Plus       23
                Adafruit Feather Huzzah32       23
    
        config I2C_CONTROLLER_SCL
            int "SCL GPIO Num"
            default 22
            help
                GPIO number for I2C Controller clock line.

                Espressif ESP32 DevKitC V4      22
                Espressif ESP32-C3 DevKitC 02   19
                Sparkfun ESP32 Thing Plus       22
                Adafruit Feather Huzzah32       22

        config I2C_CONTROLLER_PORT_NUM
            int "Port Number"
            default 0
            help
                Port number for I2C Controller device.

        config I2C_CONTROLLER_FREQUENCY
            int "Controller Frequency"
            default 400000
            help
                I2C Speed of Controller device.
                
    endmenu

    menu "I2C MCP23008 I/O Expander"
    
        config I2C_MCP23008_ADDRESS
            hex "MCP23008 Address"
            default 0x20
            help
                Hardware Address of I2C Peripheral Port.

        config GPIO_MCP23008_INTERRUPT
            int "MCP23008 Interrupt GPIO Num"
            default 23
            help
                GPIO number for MCP23008 interrupt.

                Espressif ESP32 DevKitC V4      23
                Espressif ESP32-C3 DevKitC 02   3
                Sparkfun ESP32 Thing Plus       14
                Adafruit Feather Huzzah32       14

    endmenu

endmenu
```
